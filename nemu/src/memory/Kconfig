## nemu/src/memory/Kconfig
```kconfig
menu "Memory Configuration"

config MBASE
  hex "Memory base address"
  default 0x0        if ISA_x86
  default 0x80000000

config MSIZE
  hex "Memory size"
  default 0x8000000

config PC_RESET_OFFSET
  hex "Offset of reset vector from the base of memory"
  default 0x100000 if ISA_x86
  default 0

choice
  prompt "Physical memory definition"
  default PMEM_GARRAY
config PMEM_MALLOC
  bool "Using malloc()"
config PMEM_GARRAY
  depends on !TARGET_AM
  bool "Using global array"
endchoice

config MEM_RANDOM
  depends on MODE_SYSTEM && !DIFFTEST && !TARGET_AM
  bool "Initialize the memory with random values"
  default y
  help
    This may help to find undefined behaviors.

config CACHE
  depends on MODE_SYSTEM && ENGINE_INTERPRETER && TARGET_NATIVE_ELF
  bool "Enable simulated two-level inclusive cache"
  default n
  help
    Simulate a unified, inclusive, write-back + write-allocate two-level
    cache (L1 64B, L2 256B, 8B lines) in front of the physical memory.
    MMIO accesses are not cached. Hit/miss statistics are printed at exit.

if CACHE

config CACHE_L1_WAYS
  int "L1 associativity (power of 2 dividing 8)"
  range 1 8
  default 1
  help
    Ways per L1 set: 1 = direct-mapped, 8 = fully associative.
    LRU replacement is used when the associativity is greater than 1.

config CACHE_L2_WAYS
  int "L2 associativity (power of 2 dividing 32)"
  range 1 32
  default 1
  help
    Ways per L2 set: 1 = direct-mapped, 32 = fully associative.
    LRU replacement is used when the associativity is greater than 1.

endif

endmenu #MEMORY
```
